## sdkconfig.defaults
```kconfig
CONFIG_LVGL_PORT_ENABLE_PPA=y
CONFIG_LV_USE_PPA=n
CONFIG_LV_USE_PPA_IMG=n
CONFIG_ESP_LCD_ENABLE=y
CONFIG_ESP_LCD_MIPI_DSI_ENABLE=y
CONFIG_IDF_EXPERIMENTAL_FEATURES=y
CONFIG_SPIRAM_USE_MEMMAP=n
CONFIG_SPIRAM_USE_CAPS_ALLOC=y
CONFIG_SPIRAM_SPEED_200M=y
CONFIG_MB_UART_RXD=21
CONFIG_MB_UART_TXD=22
CONFIG_MB_UART_RTS=20

# Partition table: custom layout with bigger app partition
CONFIG_PARTITION_TABLE_CUSTOM=y
CONFIG_PARTITION_TABLE_CUSTOM_FILENAME="partitions.csv"
CONFIG_PARTITION_TABLE_FILENAME="partitions.csv"
```
